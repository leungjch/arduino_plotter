#include <AFMotor.h>
#include <Servo.h>
Servo motorP;
// Connect a stepper motor with 48 steps per revolution (7.5 degree)
// to motor port #2 (M3 and M4)
AF_Stepper motorX(48, 2);
AF_Stepper motorY(48, 1);
int mY = 0;
int mX = 0;
int pos = 0;

void setup() {
// 4cm/250steps  = 0.016cm/step
// 40mm/32pixels = 0.625mm/pixel
// ~4 steps per pixel
motorP.attach(10);
  Serial.begin(9600);           // set up Serial library at 9600 bps
  Serial.println("Stepper test begin!");

  motorX.setSpeed(300);  // 10 rpm
  motorY.setSpeed(300);  // 10 rpm

    motorP.write(-130);
  // reset motor positions
  motorX.step(256, BACKWARD, DOUBLE);
  motorY.step(256, FORWARD, DOUBLE);
}

void loop() {
char image[] = 
{'b','b','b','b','b','b','b','b','b','b','b','b','b','b','b','b','b','b','b','b','b','b','b','b','b','b','b','b','b','b','b','b','b','b','b','b','b','b','b','b','b','b','b','b','b','b','b','b','b','b','b','b','b','b','b','b','b','b','b','b','b','b','b','b','n',
'b','b','b','b','b','b','b','b','b','b','b','b','b','b','b','b','b','b','b','b','b','b','b','b','b','b','b','b','b','b','b','b','b','b','b','b','b','b','b','b','b','b','b','b','b','b','b','b','b','b','b','b','b','b','b','b','b','b','b','b','b','b','b','b','n',
'b','b','b','b','b','b','b','b','b','b','b','b','b','b','b','b','b','b','b','b','b','b','b','b','b','b','b','b','b','b','b','b','b','b','b','b','b','b','b','b','b','b','b','b','b','b','b','b','b','b','b','b','b','b','b','b','b','b','b','b','b','b','b','b','n',
'b','b','b','b','b','b','b','b','b','b','b','b','b','b','b','b','b','b','b','b','b','b','b','b','b','b','b','b','b','b','b','b','b','b','b','b','b','b','b','b','b','b','b','b','b','b','b','b','b','b','b','b','b','b','b','b','b','b','b','b','b','b','b','b','n',
'b','b','b','b','b','b','b','b','b','b','b','b','b','b','b','b','b','b','b','b','b','b','b','b','b','b','b','b','b','b','b','b','b','b','b','b','b','b','b','b','b','b','b','b','b','b','b','b','b','b','b','b','b','b','b','b','b','b','b','b','b','b','b','b','n',
'b','b','b','b','b','b','b','b','b','b','b','b','b','b','b','b','b','b','b','b','b','b','b','b','b','b','b','b','b','b','b','b','b','b','b','b','b','b','b','b','b','b','b','b','b','b','b','b','b','b','b','b','b','b','b','b','b','b','b','b','b','b','b','b','n',
'b','b','b','b','b','b','b','b','b','b','b','b','b','b','b','b','b','b','b','b','b','b','b','b','b','b','b','b','b','b','b','b','b','b','b','b','b','b','b','b','b','b','b','b','b','b','b','b','b','b','b','b','b','b','b','b','b','b','b','b','b','b','b','b','n',
'b','b','b','b','b','b','b','b','b','b','b','b','b','b','b','b','b','b','b','b','b','b','b','b','b','b','b','b','b','b','b','b','b','b','b','b','b','b','b','b','b','b','b','b','b','b','b','b','b','b','b','b','b','b','b','b','b','b','b','b','b','b','b','b','n',
'b','b','b','b','b','b','b','b','b','b','b','b','b','b','b','b','b','b','b','b','b','b','b','b','b','b','b','b','b','b','b','b','b','b','b','b','b','b','b','b','b','b','b','b','b','b','b','b','b','b','b','b','b','b','b','b','b','b','b','b','b','b','b','b','n',
'b','b','b','b','b','b','b','b','b','b','b','b','b','b','b','b','b','b','b','b','b','b','b','b','b','b','b','b','b','b','w','w','w','w','w','b','b','b','b','b','b','b','b','b','b','b','b','b','b','b','b','b','b','b','b','b','b','b','b','b','b','b','b','b','n',
'b','b','b','b','b','b','b','b','b','b','b','b','b','b','b','b','b','b','b','b','b','b','b','b','w','w','w','w','w','w','w','w','w','w','w','w','w','w','w','w','w','b','b','b','b','b','b','b','b','b','b','b','b','b','b','b','b','b','b','b','b','b','b','b','n',
'b','b','b','b','b','b','b','b','b','b','b','b','b','b','b','b','b','b','b','b','b','b','b','w','w','w','w','w','w','w','w','w','w','w','w','w','w','w','w','w','w','w','w','w','b','b','b','b','b','b','b','b','b','b','b','b','b','b','b','b','b','b','b','b','n',
'b','b','b','b','b','b','b','b','b','b','b','b','b','b','b','b','b','b','b','b','b','b','b','w','w','w','w','w','w','w','w','w','w','w','w','w','w','w','w','w','w','w','w','w','w','w','b','b','b','b','b','b','b','b','b','b','b','b','b','b','b','b','b','b','n',
'b','b','b','b','b','b','b','b','b','b','b','b','b','b','b','b','b','b','b','w','b','b','b','w','w','w','w','w','w','w','w','w','w','w','w','w','w','w','w','w','w','w','w','w','w','w','w','w','b','b','b','b','b','b','b','b','b','b','b','b','b','b','b','b','n',
'b','b','b','b','b','b','b','b','b','b','b','b','b','b','b','b','b','w','w','w','b','b','b','w','w','w','w','w','w','w','w','w','w','w','w','w','w','w','w','w','w','w','w','w','w','w','w','w','w','w','b','b','b','b','b','b','b','b','b','b','b','b','b','b','n',
'b','b','b','b','b','b','b','b','b','b','b','b','b','b','b','b','w','w','w','w','b','b','b','b','b','w','w','w','w','w','w','w','w','w','w','w','w','w','w','w','w','w','w','w','w','w','w','w','w','w','w','b','b','b','b','b','b','b','b','b','b','b','b','b','n',
'b','b','b','b','b','b','b','b','b','b','b','b','b','b','b','w','w','w','b','b','b','b','b','b','b','b','b','b','w','w','w','w','w','w','w','w','w','w','w','w','w','w','w','w','w','w','w','w','w','w','w','b','b','b','b','b','b','b','b','b','b','b','b','b','n',
'b','b','b','b','b','b','b','b','b','b','b','b','b','b','w','w','w','w','b','b','b','b','w','b','b','b','b','b','b','w','w','w','w','w','w','w','w','w','w','w','w','w','w','w','w','w','w','w','w','w','w','b','b','b','b','b','b','b','b','b','b','b','b','b','n',
'b','b','b','b','b','b','b','b','b','b','b','b','b','b','b','b','b','b','b','b','w','w','w','w','w','w','b','b','b','b','b','b','w','w','w','w','w','w','w','w','w','w','w','w','w','w','w','w','w','w','w','b','b','b','b','b','b','b','b','b','b','b','b','b','n',
'b','b','b','b','b','b','b','b','b','b','b','b','b','b','b','b','b','b','b','w','w','w','w','w','w','w','w','w','b','b','b','b','b','b','w','w','w','w','w','w','w','w','w','w','w','w','w','w','w','w','b','b','b','w','w','b','b','b','b','b','b','b','b','b','n',
'b','b','b','b','b','b','b','b','w','w','w','w','w','w','w','w','b','b','b','b','w','w','w','w','w','w','w','w','w','w','b','b','b','b','b','b','w','w','w','w','w','b','b','b','b','b','b','b','b','w','b','b','b','w','w','w','b','b','b','b','b','b','b','b','n',
'b','b','b','b','b','b','w','w','w','w','w','w','w','w','w','w','w','w','b','b','b','b','w','w','w','w','w','w','w','w','w','w','b','b','b','b','b','b','b','b','b','b','b','b','b','b','b','b','b','b','b','b','w','w','w','w','b','b','b','b','b','b','b','b','n',
'b','b','b','b','w','w','w','w','w','w','w','w','w','w','w','w','w','w','w','w','b','b','b','w','w','w','w','w','w','w','w','w','w','w','b','b','b','b','b','b','b','b','b','b','b','b','b','b','b','b','b','b','w','w','w','w','w','b','b','b','b','b','b','b','n',
'b','b','b','b','w','w','w','w','w','w','w','w','w','w','w','w','w','w','w','w','w','b','b','b','w','w','w','w','w','w','w','w','w','w','w','b','b','b','b','w','w','w','w','w','w','w','w','w','w','w','b','b','b','w','w','w','w','b','b','b','b','b','b','b','n',
'b','b','b','w','w','w','w','w','w','w','w','w','w','w','w','w','w','w','w','w','w','w','b','b','b','w','w','w','w','w','w','w','w','w','w','b','b','w','w','w','w','w','w','w','w','w','w','w','w','w','w','b','b','b','w','w','w','w','b','b','b','b','b','b','n',
'b','b','w','w','w','w','w','w','w','w','w','w','w','w','w','w','w','w','w','w','w','w','w','b','b','w','w','w','w','w','w','w','w','w','w','b','b','w','w','w','w','w','w','w','w','w','w','w','w','w','w','b','b','b','w','w','w','w','b','b','b','b','b','b','n',
'b','b','w','w','w','b','b','b','w','w','w','w','w','w','w','w','b','b','w','w','w','w','w','w','b','b','w','w','w','w','w','w','w','w','w','b','b','w','w','w','w','w','w','w','w','w','w','w','w','w','w','w','b','b','b','w','w','w','w','b','b','b','w','w','n',
'b','w','w','w','b','b','b','b','w','w','w','w','w','w','w','b','b','b','b','w','w','w','w','w','b','b','w','w','w','w','w','w','w','w','w','b','b','w','w','w','w','w','w','w','w','w','w','w','w','w','w','w','b','b','b','w','w','w','w','b','w','w','w','w','n',
'b','w','w','w','b','b','b','b','w','w','w','w','w','w','b','b','b','b','b','w','w','w','w','w','w','b','b','w','w','w','w','w','w','w','w','b','b','w','w','w','w','w','w','w','w','w','w','w','w','w','w','w','w','b','b','b','w','w','w','b','b','w','w','b','n',
'b','w','w','w','b','b','b','b','w','w','w','w','w','w','w','b','b','b','b','w','w','w','w','w','w','b','b','b','w','w','w','w','w','w','w','b','b','w','w','w','w','w','w','w','w','w','w','w','w','w','w','w','w','b','b','b','w','w','b','b','b','w','w','b','n',
'w','w','w','w','w','b','b','b','w','w','w','w','w','w','w','b','b','b','w','w','w','w','w','w','w','w','b','b','w','w','w','w','w','w','w','b','b','w','w','w','w','w','w','w','w','w','w','w','w','w','w','w','w','w','b','b','w','b','b','b','b','b','b','b','n',
'w','w','w','w','w','w','w','w','w','w','w','w','w','w','w','w','w','w','w','w','w','w','w','w','w','w','b','b','w','w','w','w','w','w','b','b','b','w','w','w','w','w','w','w','w','w','w','w','w','w','w','w','w','w','b','b','b','b','b','b','b','b','b','b','n',
'w','w','w','w','w','w','w','w','w','w','w','w','w','w','w','w','w','w','w','w','w','w','w','w','w','w','b','b','b','b','w','w','w','w','b','b','b','w','w','w','w','w','w','w','w','w','w','w','w','w','w','w','w','w','b','b','b','b','b','w','w','b','b','b','n',
'w','w','w','w','w','w','w','w','w','w','w','w','w','w','w','w','w','w','w','w','w','w','w','w','w','w','w','b','b','b','w','w','w','w','b','b','b','w','w','w','w','w','w','w','w','w','w','w','w','w','w','w','w','b','b','b','b','b','w','w','w','b','b','b','n',
'w','w','w','w','w','b','b','w','w','w','w','b','b','b','w','w','w','w','w','w','w','w','w','w','w','w','w','b','b','b','b','b','w','w','b','b','b','w','w','w','w','w','w','w','w','w','w','w','w','w','w','b','b','b','b','b','w','w','w','w','w','b','b','b','n',
'b','w','w','w','w','w','b','b','b','b','b','b','b','w','w','w','w','w','w','w','w','w','w','w','w','w','w','b','b','b','b','b','w','w','b','b','b','w','w','w','w','w','w','w','w','w','w','w','b','b','b','b','b','b','b','w','w','w','w','w','w','b','b','b','n',
'b','w','w','w','w','w','w','b','b','b','b','b','w','w','w','w','w','w','w','w','w','w','w','w','w','w','w','w','b','b','b','b','b','b','b','b','b','w','w','w','w','w','w','w','b','b','b','b','b','b','b','b','b','w','w','w','w','w','w','w','b','b','b','b','n',
'b','w','w','w','w','w','w','w','w','b','w','w','w','w','w','w','w','w','w','w','w','w','w','w','w','w','w','w','b','b','b','b','b','b','b','b','b','b','b','b','b','b','b','b','b','b','b','b','b','b','w','w','w','w','w','w','w','w','w','b','b','b','b','b','n',
'b','b','w','w','w','w','w','w','w','w','w','w','w','w','w','w','w','w','w','w','w','w','w','w','w','w','w','w','b','b','w','w','b','b','b','b','b','b','b','b','b','b','b','b','b','b','w','w','w','w','w','w','w','w','w','w','w','b','b','b','b','b','b','b','n',
'b','b','w','w','w','w','w','w','w','w','w','w','w','w','w','w','w','w','w','w','w','w','w','w','w','w','w','w','b','b','w','w','w','w','b','b','b','b','b','b','b','b','w','w','w','w','w','w','w','w','w','w','w','w','w','b','b','b','b','b','b','b','b','b','n',
'b','b','b','w','w','w','w','w','w','w','w','w','w','w','w','w','w','w','w','w','w','w','w','w','w','w','w','w','b','b','w','w','w','w','w','w','w','w','w','w','w','w','w','w','w','w','w','w','w','w','w','w','w','b','b','b','b','b','b','b','b','b','b','b','n',
'b','b','b','w','w','w','w','w','w','w','w','w','w','w','w','w','w','w','w','w','w','w','w','w','w','w','w','w','b','b','b','w','w','w','w','w','w','w','w','w','w','w','w','w','w','w','w','w','w','w','w','b','b','b','b','b','b','b','w','b','b','b','b','b','n',
'b','b','b','b','w','w','w','w','w','w','w','w','w','w','w','w','w','w','w','w','w','w','w','w','w','w','w','w','b','b','b','w','w','w','w','w','w','w','w','w','w','w','w','w','w','w','w','b','b','b','b','b','b','b','b','w','w','w','w','w','b','b','b','b','n',
'b','b','b','b','b','w','w','w','w','w','w','w','w','w','w','w','w','w','w','w','w','w','w','w','w','w','w','w','w','b','b','w','w','w','w','w','w','w','w','w','w','w','w','b','b','b','b','b','b','b','b','b','b','w','w','w','w','w','w','w','b','b','b','b','n',
'b','b','b','b','b','b','b','w','w','w','w','w','w','w','w','w','w','w','w','w','w','w','w','w','w','w','w','w','w','b','b','b','b','b','b','b','b','b','b','b','b','b','b','b','b','b','b','b','b','b','w','w','w','w','w','w','w','w','w','w','b','b','b','b','n',
'b','b','b','b','b','b','b','b','b','w','w','w','w','w','w','w','w','w','w','w','w','w','w','w','w','w','w','w','w','b','b','b','b','b','b','b','b','b','b','b','b','b','b','b','b','b','b','b','b','b','w','w','w','w','w','w','w','w','w','w','w','b','b','b','n',
'b','b','b','b','b','b','b','b','b','b','b','b','w','w','w','w','w','w','w','w','w','w','w','w','w','w','w','w','w','b','b','b','b','b','b','b','b','b','b','b','b','b','b','b','b','b','b','b','b','b','w','w','w','w','w','w','w','w','w','w','w','b','b','b','n',
'b','b','b','b','b','b','b','w','b','b','b','b','b','b','b','b','b','w','w','w','w','w','w','w','w','w','w','w','b','b','b','w','w','w','w','w','w','w','b','b','b','b','b','b','b','b','b','b','b','b','w','w','w','w','w','w','w','w','w','w','w','b','b','b','n',
'b','b','b','b','b','b','w','w','w','w','w','w','b','b','b','b','b','b','b','b','b','b','b','b','b','b','b','b','b','b','w','w','w','w','w','w','w','w','w','b','b','b','b','b','b','b','b','b','b','b','b','w','w','w','w','w','w','w','w','w','b','b','b','b','n',
'b','b','b','b','b','b','w','w','w','w','w','w','w','w','w','w','b','b','b','b','b','b','b','b','b','b','b','b','b','b','w','w','w','w','w','w','w','w','w','b','b','b','b','b','b','b','b','b','b','b','b','b','w','w','w','w','w','w','b','b','b','b','b','b','n',
'b','b','b','b','b','b','w','w','w','w','w','w','w','w','w','w','b','b','b','b','b','b','b','b','b','b','b','b','b','b','w','w','w','w','w','w','w','w','w','b','b','b','b','b','b','b','b','b','b','b','b','b','b','b','b','b','b','b','b','b','b','b','b','b','n',
'b','b','b','b','b','b','w','w','w','w','w','w','w','w','w','w','w','b','b','b','b','b','b','b','b','b','b','b','b','b','w','w','w','w','w','w','w','w','w','w','b','b','b','b','b','b','b','b','b','b','b','b','b','b','b','b','b','b','b','b','b','b','b','b','n',
'b','b','b','b','b','b','w','w','w','w','w','w','w','w','w','w','b','b','b','b','b','b','b','b','b','b','b','b','b','b','w','w','w','w','w','w','w','w','w','w','b','b','b','b','b','b','b','b','b','b','b','b','b','b','b','b','b','b','b','b','b','b','b','b','n',
'b','b','b','b','b','b','b','w','w','w','w','w','w','w','w','w','b','b','b','b','b','b','b','b','b','b','b','b','b','b','w','w','w','w','w','w','w','w','w','w','b','b','b','b','b','b','b','b','b','b','b','b','b','b','b','b','b','b','b','b','b','b','b','b','n',
'b','b','b','b','b','b','b','b','b','b','b','b','b','b','b','b','b','b','b','b','b','b','b','b','b','b','b','b','b','b','w','w','w','w','w','w','w','w','w','w','b','b','b','b','b','b','b','b','b','b','b','b','b','b','b','b','b','b','b','b','b','b','b','b','n',
'b','b','b','b','b','b','b','b','b','b','b','b','b','b','b','b','b','b','b','b','b','b','b','b','b','b','b','b','b','b','w','w','w','w','w','w','w','w','b','b','b','b','b','b','b','b','b','b','b','b','b','b','b','b','b','b','b','b','b','b','b','b','b','b','n',
'b','b','b','b','b','b','b','b','b','b','b','b','b','b','b','b','b','b','b','b','b','b','b','b','b','b','b','b','b','b','b','b','b','b','b','b','b','b','b','b','b','b','b','b','b','b','b','b','b','b','b','b','b','b','b','b','b','b','b','b','b','b','b','b','n'};
//motorP.write(-130);
Serial.println("Image loaded!");

// pen down
//motorP.write(130);

for (int i = 0; i < 4096; i++)
{
    
  for (int j = 0; j < 1; j++)
  {
    // pen down on all values of 1
    if (image[i] == 'w')
    {
      motorP.write(130);

      delay(200);
      motorY.step(4, BACKWARD, DOUBLE);
      delay(200);
      
      motorP.write(-130);
      delay(200);
    }
  
    // pen up on all values of 0
    if (image[i] == 'b')
    {
      motorP.write(-130);
      delay(200);
      motorY.step(4, BACKWARD, DOUBLE);
    }
  }
  // new line indicator: move x axis back to initial position and move forward in y axis by 1 pixel
  if (image[i] == 'n')
  {
    motorP.write(-130);
    motorX.step(4, FORWARD, DOUBLE);
    motorY.step(256, FORWARD, DOUBLE);
  }
}
/*
for (int i = 0; i < 256; i++)
{
  motorY.step(1, BACKWARD, DOUBLE);
  int coinFlip = random(1,3);
  if (coinFlip == 1)
  {
    motorX.step(10, BACKWARD, DOUBLE);
  }
  else
  motorX.step(10, FORWARD, DOUBLE);
}
*/
Serial.println("Finished!");
delay(25000000);
}
